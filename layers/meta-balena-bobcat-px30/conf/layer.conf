## layers/meta-balena-bobcat-px30/conf/layer.conf
```bitbake
BBPATH .= ":${LAYERDIR}"

BBFILES += "${LAYERDIR}/recipes-*/*/*.bb \
            ${LAYERDIR}/recipes-*/*/*.bbappend"

BBFILE_COLLECTIONS += "balena-bobcat-px30"
BBFILE_PATTERN_balena-bobcat-px30 := "^${LAYERDIR}/"
BBFILE_PRIORITY_balena-bobcat-px30 = "1337"

LAYERSERIES_COMPAT_balena-bobcat-px30= "kirkstone"

# we do not use Rockchip's u-boot
BBMASK += "meta-rockchip/recipes-bsp/u-boot"
```

## layers/meta-balena-bobcat-px30/conf/machine/bobcat-px30.conf
```bitbake
#@TYPE: Machine
#@NAME: Bobcat PX30

SOC_FAMILY = "px30"

RK_ISP_VERSION := "1"

require conf/machine/include/soc-family.inc
require conf/machine/include/arm/arch-armv8a.inc

PREFERRED_PROVIDER_virtual/bootloader = "u-boot-rockchip"
PREFERRED_PROVIDER_virtual/kernel = "linux-rockchip"
PREFERRED_VERSION_linux-rockchip = "4.4%"

SERIAL_CONSOLES = "1500000;ttyFIQ0"
KERNEL_IMAGETYPE = "Image"
KBUILD_DEFCONFIG = "px30_linux_defconfig"
KERNEL_DEVICETREE = "rockchip/px30-bobcat.dtb"
BALENA_DISABLE_KERNEL_HEADERS = "1"

UBOOT_MACHINE = "evb-px30_defconfig"
```
